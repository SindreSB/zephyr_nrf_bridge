## app/boards/arm/n_bridge/Kconfig
```kconfig
# Kconfig - nBridge board configuration

if BOARD_NBRIDGE

config BOARD_ENABLE_DCDC
	bool "Enable DCDC mode"
	select SOC_DCDC_NRF52X
	default y

endif # BOARD_NBRIDGE
```

## app/boards/arm/n_bridge/Kconfig.board
```kconfig
# Kconfig - nBridge board configuration

config  BOARD_NBRIDGE
	bool "N BRIDGE"
	depends on SOC_NRF52832_QFAA
```

## app/boards/arm/n_bridge/Kconfig.defconfig
```kconfig
# Kconfig - BL652 DVK board configuration
#
# Copyright (c) 2019 Laird Connectivity
#
# SPDX-License-Identifier: Apache-2.0

if BOARD_NBRIDGE

config BOARD
	default "nBridge"

if ADC

config ADC_0
	default y

endif # ADC


if SPI

config SPI_2
	default y

endif # SPI

config BT_CTLR
	default BT

endif # BOARD_NBRIDGE
```

## app/boards/arm/n_bridge/n_bridge_defconfig
```kconfig
CONFIG_ARM=y
CONFIG_SOC_FAMILY_NRF=y
CONFIG_SOC_SERIES_NRF52X=y
CONFIG_SOC_NRF52832_QFAA=y
CONFIG_BOARD_NBRIDGE=y

# Enable MPU
CONFIG_ARM_MPU=y

# Enable RTT
CONFIG_HAS_SEGGER_RTT=y
CONFIG_USE_SEGGER_RTT=y

# Enable console
CONFIG_CONSOLE=y
CONFIG_RTT_CONSOLE=y

# Additional board options
CONFIG_GPIO_AS_PINRESET=y

# 32kHz clock source
CONFIG_CLOCK_CONTROL_NRF_K32SRC_RC=y
CONFIG_CLOCK_CONTROL_NRF_K32SRC_500PPM=y
```

## app/boards/arm/nrf_breakout/Kconfig.board
```kconfig
# Kconfig - nRF52 PCA10040 board configuration
#
# Copyright (c) 2016 Nordic Semiconductor ASA
#
# SPDX-License-Identifier: Apache-2.0

config  BOARD_NRF_BREAKOUT
	bool "nRF BREAKOUT"
	depends on SOC_NRF52832_QFAA
```

## west.yml
```yaml
west:
  url: https://github.com/zephyrproject-rtos/west
  revision: master

manifest:
  defaults:
    remote: zephyr-base

  remotes:
    - name: project-base
      url-base: https://github.com/SindreSB/zephyr_nrf_bridge
    - name: zephyr-base
      url-base: https://github.com/zephyrproject-rtos

  # The initial list of external projects is just Zephyr's net-tools
  # repository, which is useful for running the Zephyr networking
  # stack in QEMU.
  #
  # This will grow over time as external code is migrated into its own
  # repositories.
  projects:
    - name: zephyr
      revision: master
      west-commands: scripts/west-commands.yml

    - name: net-tools
      revision: 30b7efa827b04d2e47840716b0372737fe7d6c92

  self:
    path: app
    
```
